## components/bluetooth/Kconfig.projbuild
```kconfig
menu "Bluetooth Configuration"

    config ENABLE_BLUETOOTH
            bool "Enable Bluetooth"
            default n
            help
                Enable or disable sending received packet over Bluetooth.
    
    config BT_DEVICE_NAME
        string "Bluetooth Device Name"
        default "BuzzVerse 🐝"
        help
            Name of the Bluetooth device.
    
    config BT_DEVICE_UUID
        string "Bluetooth Device UUID16"
        default "FACE"
        help
            Set the Bluetooth device 16-bit UUID.

endmenu
```

## components/bme280/Kconfig.projbuild
```kconfig
menu "BME280 configuration"
    config BME280_I2C_ADDRESS
        hex "I2C address"
        default (0x76)
        help
            I2C address of the BME280 sensor
endmenu
```

## components/bmi160/Kconfig.projbuild
```kconfig
menu "BMI160 Configuration"

	menu "SDA Pin"
		config BMI160_I2C_SCL
			int "SCL GPIO Num"
			default 0
			help
				GPIO number for I2C Master clock line.
        	config BMI160_I2C_SDA
            		int "SDA GPIO Num"
            		default 1
            		help
                		GPIO number for I2C Master data line.

		endmenu
	menu "Master Frequency"
		config BMI160_I2C_MASTER_FREQ
			int "Master frequency"
			default 400000
			help
				I2C Speed of the Master device.
	endmenu
endmenu
```

## components/crypto/Kconfig.projbuild
```kconfig
menu "Crypto configuration"
    depends on ENABLE_CRYPTO

    config CRYPTO_KEY
        string "Key"
        default "1234567890123456"
        help
          Key for encryption/decryption
endmenu
```

## components/gauge/Kconfig.projbuild
```kconfig
menu "BQ27441 Fuel Gauge Configuration"
    config BQ27441_I2C_ADDRESS
        hex "I2C address"
        default 0x55
        help
            I2C address of the BQ27441 fuel gauge.

    config BQ27441_DESIGN_CAPACITY
        int "Design Capacity (mAh)"
        default 3400
        help
            The design capacity of the battery in mAh.

    config BQ27441_TERMINATE_VOLTAGE
        int "Terminate Voltage (mV)"
        default 3200
        help
            The terminate voltage of the battery in mV.

endmenu
```

## components/i2c/Kconfig.projbuild
```kconfig
menu "I2C configuration"
    config I2C_MASTER_SCL_IO 
        int "Master SCL pin"
        default 18
        help
            Pin the master SCL line is connected to
    
    config I2C_MASTER_SDA_IO
        int "Master SDA pin"
        default 17
        help
            Pin the master SDA line is connected to
    
    config I2C_MASTER_ENABLED
        int "I2C master enabled"
        default 6
        help
            Pin the master enabled line is connected to

    config I2C_MASTER_FREQ_HZ
        int "I2C master frequency"
        default 100000
        help
            I2C master clock frequency in Hz
endmenu
```

## components/lora/Kconfig.projbuild
```kconfig
menu "LoRa Configuration"

    choice
        prompt "Class that LoRa works in."
        default LORA_RECEIVER
        help
            Select the class in which LoRa operates.

        config LORA_RECEIVER
            bool "Receiver"
            help
                Receiver puts the device into receiving mode.

        config LORA_TRANSMITTER
            bool "Transmitter"
            help
                Transmitter puts the device into transmitting mode.

    endchoice

    menu "GPIO Config"

        config GPIO_RANGE_MAX
            int
            default 33 if IDF_TARGET_ESP32
            default 46 if IDF_TARGET_ESP32S2
            default 48 if IDF_TARGET_ESP32S3
            default 18 if IDF_TARGET_ESP32C2
            default 19 if IDF_TARGET_ESP32C3
            default 30 if IDF_TARGET_ESP32C6

        config MISO_GPIO
            int "MISO GPIO"
            range 0 GPIO_RANGE_MAX
            default 4
            help
                Pin Number to be used as the MISO SPI signal.

        config SCK_GPIO
            int "SCK GPIO"
            range 0 GPIO_RANGE_MAX
            default 5
            help
                Pin Number to be used as the SCK SPI signal.

        config MOSI_GPIO
            int "MOSI GPIO"
            range 0 GPIO_RANGE_MAX
            default 8
            help
                Pin Number to be used as the MOSI SPI signal.

        config CS_GPIO
            int "NSS GPIO"
            range 0 GPIO_RANGE_MAX
            default 10
            help
                Pin Number where the NCS pin of the LoRa module is connected to.

        config RST_GPIO
            int "RST GPIO"
            range 0 GPIO_RANGE_MAX
            default 3
            help
                Pin Number where the NRST pin of the LoRa module is connected to.
    endmenu

    menu "LoRa Parameters Config"

        config LORA_FREQUENCY
            int "LoRa Frequency (MHz)"
            range 169 915
            default 433
            help
                Set the operating frequency for the LoRa module in MHz.
                Common frequencies are:
                - 169 for 169 MHz
                - 433 for 433 MHz
                - 470 for 470 MHz
                - 866 for 866 MHz
                - 915 for 915 MHz

        config LORA_CODING_RATE
            int "LoRa Coding Rate"
            range 5 8
            default 8
            help
                Set the coding rate for the LoRa module.
                Coding rates can be 5 (4/5), 6 (4/6), 7 (4/7), or 8 (4/8).

        config LORA_BANDWIDTH
            int "LoRa Bandwidth"
            range 0 9
            default 3
            help
                Set the bandwidth for the LoRa module.
                Bandwidth can be 0 to 9.

        config LORA_SPREADING_FACTOR
            int "LoRa Spreading Factor"
            range 6 12
            default 12
            help
                Set the spreading factor for the LoRa module.
                Spreading factors can be 6 to 12.

        config LORA_CRC
            bool "Enable CRC"
            default y
            help
                Enable or disable CRC for the LoRa module.
    endmenu
endmenu
```

## components/low_power_mode/Kconfig.projbuild
```kconfig
menu "Sleep configuration"
    config LOW_POWER_MODE_SLEEP_TIME_SEC 
        int "Sleep time in seconds"
        default 60
        help
          Sleep time in seconds
endmenu
```

## main/Kconfig.projbuild
```kconfig
menu "App Configuration"

    config PACKET_VERSION
        int "Packet Version"
        range 0 15
        default 0
        help
            Version of the packet.

    config CLASS_ID
        int "ID of class"
        range 0 15
        default 0
        help
            ID of the device's class.

    config DEVICE_ID
        int "Device ID"
        range 0 15
        default 0
        help
            ID of the device.

    config DATA_TYPE
        int "Data Type"
        range 0 255
        default 0
        help
            Type of data to be sent.

    config ENABLE_MQTT
            bool "Enable MQTT"
            depends on LORA_RECEIVER
            default y
            help
                Enable or disable sending received packet over MQTT.

endmenu
```
